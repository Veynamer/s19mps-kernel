&bat {
	charge-full-design-microamp-hours = <4096000>;
	constant-charge-voltage-max-microvolt = <4400000>;

	ocv-capacity-table-0 =  
	                           <4362000  100>,
	                           <4316000  95>,
	                           <4256000  90>,
	                           <4197000  85>,
	                           <4142000  80>,
	                           <4089000  75>,
	                           <4040000  70>,
	                           <3981000  65>,
	                           <3941000  60>,
	                           <3890000  55>,
	                           <3853000  50>,
	                           <3826000  45>,
	                           <3805000  40>,
	                           <3788000  35>,
	                           <3776000  30>,
	                           <3767000  25>,
	                           <3751000  20>,
	                           <3725000  15>,
	                           <3693000  10>,
	                           <3675000  5>,
	                           <3400000  0>;

	charge-sdp-current-microamp = <500000 500000>;
	charge-dcp-current-microamp = <2000000 2000000>;
	charge-cdp-current-microamp = <2000000 2000000>;
	charge-unknown-current-microamp = <2000000 2000000>;

	charge-term-current-microamp = <130000>;
	factory-internal-resistance-micro-ohms = <268000>;
	voltage-min-design-microvolt = <3500000>;

	fullbatt-voltage = <4370000>;
	fullbatt-current = <180000>;
	fullbatt-track-end-vol = <4360000>;
	fullbatt-track-end-cur = <190000>;
	first-calib-voltage = <3675000>;
	first-calib-capacity = <50>;

	voltage-temp-table = <1005630 800>, <961550 850>, <808210 900>,
					<779490 950>, <683910 1000>, <529350 1050>,
					<526670 1100>, <464980 1150>, <356810 1200>,
					<347140 1250>, <262100 1300>, <255080 1350>,
					<187960 1400>, <158960 1450>, <136280 1500>,
					<119090 1550>, <108680 1600>, <80490 1650>,
					<73820 1700>, <67460 1750>, <58900 1800>;
					
	dcp-jeita-temp-table =
          <1000 1030 0 4400000>,
          <1150 1130 2000000 4400000>,
          <1450 1420 2000000 4400000>,
          <1700 1560 2000000 4400000>;

	sdp-jeita-temp-table =
          <1000 1030 0 4400000>,
          <1150 1130 500000 4400000>,
          <1450 1420 500000 4400000>,
          <1700 1560 500000 4400000>;

	cdp-jeita-temp-table =
          <1000 1030 0 4400000>,
          <1150 1130 2000000 4400000>,
          <1450 1420 2000000 4400000>,
          <1700 1560 2000000 4400000>;

	unknown-jeita-temp-table =
          <1000 1030 0 4400000>,
          <1150 1130 2000000 4400000>,
          <1450 1420 2000000 4400000>,
          <1700 1560 2000000 4400000>;

};

&pmic_fgu {
  sprd,calib-resistance-micro-ohms = <4850>;
  sprd,comp-resistance-mohm = <20>;
};
