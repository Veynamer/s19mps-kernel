/*
/ {
	fragment {
		target-path = "/";
		__overlay__ {

		prox_ldo:prox-ldo {
			compatible = "revo,prox_ldo";
			proxldo-gpio = <&ap_gpio 131 GPIO_ACTIVE_LOW>;
		};

		};
	};
};
*/

&vddkpled {
	regulator-always-on;
};
