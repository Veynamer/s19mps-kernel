#include "revo_cfg/revo_custom_otg.dtsi"
#include "revo_cfg/revo_battery.dtsi"
#include "revo_cfg/revo_custom_camera.dtsi"
#include "revo_cfg/revo_custom_keys.dtsi"
#include "revo_cfg/revo_custom_sound.dtsi"
#include "revo_cfg/revo_custom_tf_hotplug.dtsi"
#include "revo_cfg/normal_charge.dtsi"
#include "revo_cfg/revo_custom_fp.dtsi"
#include "revo_cfg/revo_prox_power.dtsi"
#include "revo_cfg/revo_custom_tp.dtsi"
#include "revo_cfg/revo_backlight.dtsi"