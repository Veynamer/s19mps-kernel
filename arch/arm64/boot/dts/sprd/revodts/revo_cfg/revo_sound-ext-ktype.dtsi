&sound_vbc_v4_sprd_codec {
 	status = "okay";

 	/*ext_control_type, hook selection, mode, gpio share*/
 	sprd,spk-ext-pa-info = <0 0 3 0>,<1 0 3 0>;
 	sprd,spk-ext-pa-gpio = <&ap_gpio 136 0>,<&ap_gpio 137 0>;
};
