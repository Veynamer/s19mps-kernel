&pwm_backlight{
      brightness-levels = <
               0   3   4   5   6   7   8   9   10  11
               12  13  14  15  16  17  18  19  20  21
               23  25  27  29  31  33  35  37  39  41
               43  45  47  49  51  53  55  57  59  61
               63  65  67  69  71  73  75  77  79  81
               83  85  87  89  91  93  95  97  99 101
              103 105 107 109 111 113 115 117 119 121
              123 125 127 129 131 133 135 137 139 141
              143 146 149 152 155 158 161 164 167 170
              173 176 179 182 185 188 191 194 197 200
              203 206 209 212 215 218 221 224 227 230
              233 237 241 245 248 252 256 260 264 268
              272 276 280 284 288 292 296 300 304 308
              312 316 320 324 328 332 336 342 346 350
              355 360 365 370 375 380 385 390 395 400
              406 412 418 424 430 436 442 448 454 460
              466 472 478 484 490 496 502 508 514 519
              524 530 536 542 548 554 560 566 572 578
              584 590 596 602 608 614 620 626 632 638
              644 650 656 662 670 676 682 688 694 700
              706 712 718 724 730 736 742 748 754 760
              766 772 778 784 790 796 802 808 814 820
              826 832 838 844 850 856 862 868 874 880
              886 892 898 904 910 916 922 928 934 940
              945 950 955 960 965 970 975 980 985 990
              995 1000 1006 1012 1018 1023
      >;
};